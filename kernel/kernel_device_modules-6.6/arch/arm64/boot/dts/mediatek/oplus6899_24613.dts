// SPDX-License-Identifier: (GPL-2.0 OR MIT)
/*
 * Copyright (C) 2022 MediaTek Inc.
 */
#include "k6899v1_64.dts"

&low_battery_throttling {
	thd-volts-h-2s = <
			4500 4400 4139>;
};

&peak_power_budget {
	battery0-path-rac-t3 = <68>;
};

/*End of this file, DO NOT ADD ANYTHING HERE*/
